## CMakeLists.txt
```
cmake_minimum_required(VERSION 3.13.1)

include($ENV{ZEPHYR_BASE}/cmake/app/boilerplate.cmake NO_POLICY_SCOPE)
project(Medidor)


list(APPEND HEADERS
    "${PROJECT_BINARY_DIR}/include/generated"
    "${PROJECT_BINARY_DIR}/zephyr/include/generated"
    "${PROJECT_SOURCE_DIR}/include"
    )

list(APPEND SOURCES
    "${PROJECT_SOURCE_DIR}/src/main.c"
	"${PROJECT_SOURCE_DIR}/src/ina.c"
	"${PROJECT_SOURCE_DIR}/src/button.c"
	"${PROJECT_SOURCE_DIR}/src/ble.c"

)

include_directories(${HEADERS})
target_sources(app PRIVATE ${SOURCES})
```

## prj.conf
```kconfig
# Enable debug
CONFIG_PRINTK=y
CONFIG_GPIO=y
CONFIG_SHELL=y
CONFIG_KERNEL_SHELL=y
CONFIG_DEVICE_SHELL=y
CONFIG_I2C=y

# Incresed stack due to settings API usage
CONFIG_SYSTEM_WORKQUEUE_STACK_SIZE=2048

CONFIG_BT=y
CONFIG_BT_DEBUG_LOG=y
CONFIG_BT_SMP=y
CONFIG_BT_SIGNING=y
CONFIG_BT_PERIPHERAL=y
CONFIG_BT_GATT_DIS=y
CONFIG_BT_ATT_PREPARE_COUNT=5
CONFIG_BT_PRIVACY=y
CONFIG_BT_DEVICE_NAME="Teste do BLE do medidor"
CONFIG_BT_DEVICE_APPEARANCE=833
CONFIG_BT_DEVICE_NAME_DYNAMIC=y
CONFIG_BT_DEVICE_NAME_MAX=65

CONFIG_BT_SETTINGS=y
CONFIG_FLASH=y
CONFIG_FLASH_PAGE_LAYOUT=y
CONFIG_FLASH_MAP=y
CONFIG_FCB=y
CONFIG_SETTINGS=y
CONFIG_SETTINGS_FCB=y
```

## src/main.c
```c
/*
 * @file main.c
 * @author Maria Tatiane Medeiros dos Santos
 * @author Glauber de Arruda Braga
 * 
 */
#include <errno.h>
#include <stddef.h>
#include <stdio.h>
#include <string.h>
#include <zephyr.h>
#include <gpio.h>
#include <shell/shell.h>
#include <stdlib.h>
#include <misc/__assert.h>
#include <device.h>
#include <i2c.h>

#include "ina.h"
#include "button.h"
#include "ble.h"

/* Sleep time */
#define SLEEP_TIME	500

/* size of stack area used by each thread */
#define STACKSIZE 1024

/* scheduling priority used by each thread */
#define PRIORITY 7

// endereço do INA219
#define I2C_SLV_ADDR	0x40
// calibração
#define CAL_VAL		(4096)

// botão
static struct button btn;
// estados: 0 - reg corrente, 1 - reg tensao, 2 - reg potencia
static u8_t state = 0;
static int global_ina = 0;

static int reset(const struct shell *shell, size_t argc, char **argv){
	shell_print(shell, "Reset\n");
	state = 0;
	return 0;
}

static int setCurrent(const struct shell *shell, size_t argc, char **argv){
	shell_print(shell, "Medindo corrente\n");
	state = 0;
	return 0;
}
static int setPower(const struct shell *shell, size_t argc, char **argv){
	shell_print(shell, "Medindo potência\n");
	state = 2;
	return 0;
}
static int setVoltage(const struct shell *shell, size_t argc, char **argv){
	shell_print(shell, "Medindo tensão\n");
	state = 1;
	return 0;
}

void setStatus(const struct shell *shell, size_t argc, char **argv){
	u8_t i = atoi(argv[1]);
	if (i >=0 && i<3){
		state = i;
	}
}

SHELL_STATIC_SUBCMD_SET_CREATE(medidor_sub,
	SHELL_CMD_ARG(reset, NULL, "Reset.", reset, 1, NULL),
	SHELL_CMD_ARG(current, NULL, "Medindo corrente.", setCurrent, 1, NULL),
	SHELL_CMD_ARG(power, NULL, "Medindo potência.", setPower, 1, NULL),
	SHELL_CMD_ARG(voltage, NULL, "Medindo tensão.", setVoltage, 1, NULL),
	SHELL_CMD_ARG(change, NULL, "Muda estado para x.", setStatus, 2, NULL),
	SHELL_SUBCMD_SET_END /* Array terminated. */
);
SHELL_CMD_REGISTER(medidor, &medidor_sub, "Comandos usando shell.", NULL);

void changeStatus(){
	if(state == 0) {
		state = 1;
	}
	else if(state == 1){
		state = 2;
	}
	else{
		state = 0;	
	}
	printf("state: %d\n", state);
}

void fromEncoder(int value){
	if(value < 0){
		state = 0;
	}
	else if( value > 0){
		state = 2;
	}
	else state = 1;
	printf("state: %d\n", state);
}


void ina1(void)
{
	ina_calibration();
	while(1){
		global_ina = ina(state);
		k_sleep(DELAY);
	}
	
}


void status(void){

	button_configure(&btn, changeStatus);
	int counter = 0;
	int prev = 0;
	while (1) {
		u32_t valA = 0U;
		u32_t valB = 0U;
		//button_read(&btn, &value);
		valA = button_read_pinA(&btn);
		valB = button_read_pinB(&btn);
		
		if (valB > valA && counter < 2){ 
			counter++;
		} 
		else if(valA > valB && counter > -2) {
			counter--;
		}
		
		if(prev != counter){
			//printk("%d\n",counter);
			fromEncoder(counter);
		}
		prev = counter;
		
		k_sleep(100);
	}
	
}


void init_ble(void){
	
	vnd_init();
		
	while(1){
		vnd_notify(state, global_ina);
		k_sleep(SLEEP_TIME);
	}
	
}	



// Threads

K_THREAD_DEFINE(ina_1, STACKSIZE, ina1, NULL, NULL, NULL,
		PRIORITY, 0, K_NO_WAIT);
K_THREAD_DEFINE(button, STACKSIZE, status, NULL, NULL, NULL,
		PRIORITY, 1, K_NO_WAIT);
K_THREAD_DEFINE(ble, STACKSIZE, init_ble, NULL, NULL, NULL,
		PRIORITY, 0, K_NO_WAIT);
```

## include/ble.h
```c
#include <zephyr/types.h>
#include <stddef.h>
#include <string.h>
#include <stdlib.h>
#include <errno.h>
#include <misc/printk.h>
#include <misc/byteorder.h>
#include <zephyr.h>
#include <settings/settings.h>

#include <bluetooth/bluetooth.h>
#include <bluetooth/hci.h>
#include <bluetooth/conn.h>
#include <bluetooth/uuid.h>
#include <bluetooth/gatt.h>



/* Custom Service Variables */
static char vnd_message[] = {'c', 'u', 'r', 'r', '.', ':', ' ',' ', ' ', ' ', ' ', ' ', ' ','m','A' };

static struct bt_uuid_128 vnd_uuid = BT_UUID_INIT_128(
	0xf0, 0xde, 0xbc, 0x9a, 0x78, 0x56, 0x34, 0x12,
	0x78, 0x56, 0x34, 0x12, 0x78, 0x56, 0x34, 0x12);

static struct bt_uuid_128 vnd_enc_uuid = BT_UUID_INIT_128(
	0xf1, 0xde, 0xbc, 0x9a, 0x78, 0x56, 0x34, 0x12,
	0x78, 0x56, 0x34, 0x12, 0x78, 0x56, 0x34, 0x12);

static struct bt_uuid_128 vnd_auth_uuid = BT_UUID_INIT_128(
	0xf2, 0xde, 0xbc, 0x9a, 0x78, 0x56, 0x34, 0x12,
	0x78, 0x56, 0x34, 0x12, 0x78, 0x56, 0x34, 0x12);

static const struct bt_uuid_128 vnd_long_uuid = BT_UUID_INIT_128(
	0xf3, 0xde, 0xbc, 0x9a, 0x78, 0x56, 0x34, 0x12,
	0x78, 0x56, 0x34, 0x12, 0x78, 0x56, 0x34, 0x12);
	
	
	
static u8_t testing;
static struct bt_gatt_ccc_cfg  ess_ccc_cfg[BT_GATT_CCC_MAX] = {};
static int outp = 0;

	
	
void vnd_init(void);
void vnd_notify(u8_t st, int val);
```

## include/button.h
```c
#include <zephyr.h>
#include <device.h>
#include <gpio.h>

#define PORT SW0_GPIO_CONTROLLER

#define INTERRUPT   GPIO_INT
#define FALL_EDGE   (GPIO_INT_EDGE | GPIO_INT_ACTIVE_LOW)
#define DEBOUNCE    GPIO_INT_DEBOUNCE
#define PULL_UP     GPIO_PUD_PULL_UP

#define SW_FLAGS    (GPIO_DIR_IN | INTERRUPT | FALL_EDGE | DEBOUNCE | PULL_UP)

#define BUTTON 18
#define PIN_A 16
#define PIN_B 17

struct button{
    struct device *device;
    struct gpio_callback gpio_callback;
};


void button_configure(struct button *btn, gpio_callback_handler_t cb);
void button_read(struct button *btn, u32_t *state);
u32_t button_read_pinA(struct button *btn);
u32_t button_read_pinB(struct button *btn);
```

## include/ina.h
```c
#include <zephyr.h>
#include <stdio.h>
#include <device.h>
#include <i2c.h>

#include <device.h>
#include <i2c.h>
#include <gpio.h>
#include <misc/__assert.h>
#include <string.h>


// endereço do INA219
#define I2C_SLV_ADDR	0x40
// calibração
#define CAL_VAL		(4096)


/* With default calibration above,
 * Each current LSB is 100 uA == 0.1 mA == 0.0001 A.
 * Each power LSB is 2000 uW == 2 mW = 0.002W.
 */
#define CUR_LSB		100
#define PWR_LSB		2000

/* Sleep time */
#define DELAY	1000



int read_reg16(struct device *i2c_dev, u8_t reg_addr, u8_t *data);

int write_reg16(struct device *i2c_dev, u8_t reg_addr, u8_t *data);

void ina_calibration(void);

u32_t ina(u8_t st);
```

## src/ble.c
```c
#include "ble.h"


static void ess_ccc_cfg_changed(const struct bt_gatt_attr *attr,
				 u16_t value)
{
	testing = (value == BT_GATT_CCC_NOTIFY) ? 1 : 0;
}



/* Vendor Primary Service Declaration */
BT_GATT_SERVICE_DEFINE(vnd_svc,
	BT_GATT_PRIMARY_SERVICE(&vnd_uuid),
	BT_GATT_CHARACTERISTIC(&vnd_enc_uuid.uuid,
			       BT_GATT_CHRC_READ | BT_GATT_CHRC_NOTIFY,
			       BT_GATT_PERM_READ, NULL, NULL, NULL),
	BT_GATT_CCC(ess_ccc_cfg, ess_ccc_cfg_changed),
	
	BT_GATT_CHARACTERISTIC(&vnd_long_uuid.uuid, BT_GATT_CHRC_READ |
			      BT_GATT_CHRC_READ | BT_GATT_CHRC_NOTIFY,
			      BT_GATT_PERM_READ, NULL, NULL, NULL),
	BT_GATT_CCC(ess_ccc_cfg, ess_ccc_cfg_changed),
);



static const struct bt_data ad[] = {
	BT_DATA_BYTES(BT_DATA_FLAGS, (BT_LE_AD_GENERAL | BT_LE_AD_NO_BREDR)),
	BT_DATA_BYTES(BT_DATA_UUID16_ALL,
		      0x0d, 0x18, 0x0f, 0x18, 0x05, 0x18),
	BT_DATA_BYTES(BT_DATA_UUID128_ALL,
		      0xf0, 0xde, 0xbc, 0x9a, 0x78, 0x56, 0x34, 0x12,
		      0x78, 0x56, 0x34, 0x12, 0x78, 0x56, 0x34, 0x12),
};

static void connected(struct bt_conn *conn, u8_t err)
{
	if (err) {
		printk("Connection failed (err %u)\n", err);
	} else {
		printk("Connected\n");
	}
}

static void disconnected(struct bt_conn *conn, u8_t reason)
{
	printk("Disconnected (reason %u)\n", reason);
}

static struct bt_conn_cb conn_callbacks = {
	.connected = connected,
	.disconnected = disconnected,
};

static void bt_ready(int err)
{
	if (err) {
		printk("Bluetooth init failed (err %d)\n", err);
		return;
	}

	printk("Bluetooth initialized\n");

	
	if (IS_ENABLED(CONFIG_SETTINGS)) {
		settings_load();
	}

	err = bt_le_adv_start(BT_LE_ADV_CONN_NAME, ad, ARRAY_SIZE(ad), NULL, 0);
	if (err) {
		printk("Advertising failed to start (err %d)\n", err);
		return;
	}

	printk("Advertising successfully started\n");
}

static void auth_passkey_display(struct bt_conn *conn, unsigned int passkey)
{
	char addr[BT_ADDR_LE_STR_LEN];

	bt_addr_le_to_str(bt_conn_get_dst(conn), addr, sizeof(addr));

	printk("Passkey for %s: %06u\n", addr, passkey);
}

static void auth_cancel(struct bt_conn *conn)
{
	char addr[BT_ADDR_LE_STR_LEN];

	bt_addr_le_to_str(bt_conn_get_dst(conn), addr, sizeof(addr));

	printk("Pairing cancelled: %s\n", addr);
}

static struct bt_conn_auth_cb auth_cb_display = {
	.passkey_display = auth_passkey_display,
	.passkey_entry = NULL,
	.cancel = auth_cancel,
};




void vnd_init(void){
	int err;

	err = bt_enable(bt_ready);
	if (err) {
		printk("Bluetooth init failed (err %d)\n", err);
		return;
	}
	
	bt_conn_cb_register(&conn_callbacks);
	bt_conn_auth_cb_register(&auth_cb_display);
	
}

void vnd_notify(u8_t st, int val){
		
	if(st == 0U)
	{

		vnd_message[0] ='c';
		vnd_message[1] ='u';
		vnd_message[2] ='r';
		vnd_message[3] ='r';
		vnd_message[4] ='.';
		vnd_message[5] = ':'; 
		vnd_message[6] ='0';
		vnd_message[7] = '0';
		vnd_message[8] ='0';
		vnd_message[9] = '0';
		vnd_message[10] = '0';
		vnd_message[11] = '0';
		vnd_message[12] ='0';
		vnd_message[13] ='m';
		vnd_message[14] ='A';

		
		
	}
	else if(st == 1U){
		vnd_message[0] ='v';
		vnd_message[1] ='o';
		vnd_message[2] ='l';
		vnd_message[3] ='t';
		vnd_message[4] ='.';
		vnd_message[5] = ':'; 

		vnd_message[6] ='0';
		vnd_message[7] = '0';
		vnd_message[8] ='0';
		vnd_message[9] = '0';
		vnd_message[10] = '0';
		vnd_message[11] = '0';
		vnd_message[12] ='0';
		vnd_message[13] ='m';
		vnd_message[14] ='V';

		
	}
	else{
		vnd_message[0] ='p';
		vnd_message[1] ='w';
		vnd_message[2] ='r';
		vnd_message[3] ='.';
		vnd_message[4] =':';
		vnd_message[5] = '0'; 
		vnd_message[6] ='0';
		vnd_message[7] = '0';
		vnd_message[8] ='0';
		vnd_message[9] = '0';
		vnd_message[10] = '0';
		vnd_message[11] = '0';
		vnd_message[12] ='0';
		vnd_message[13] ='u';
		vnd_message[14] ='W';

	}
	
	outp = val;
	int i = 12;
	char aux1;
	while(val > 10 && i >5 ){
		aux1 = (val%10) + 48;
		vnd_message[i] = aux1;
		i--;
		val = val/10;
	}
	if(i > 4) vnd_message[i] = val+ 48;;

	
	
	bt_gatt_notify(NULL, &vnd_svc.attrs[2], &vnd_message, sizeof(vnd_message));
	//bt_gatt_notify(NULL, &vnd_svc.attrs[4], &val, sizeof(val));
	
}
```

## src/button.c
```c
#include "button.h"

void button_configure(struct button *btn, gpio_callback_handler_t cb){
	btn->device = device_get_binding(PORT);
	if(btn->device != NULL){
		gpio_pin_configure(btn->device, BUTTON, SW_FLAGS);
		gpio_init_callback(&btn->gpio_callback, cb, BIT(BUTTON));
		gpio_add_callback(btn->device, &btn->gpio_callback);
		gpio_pin_enable_callback(btn->device, BUTTON);
		
		gpio_pin_configure(btn->device, PIN_A, SW_FLAGS);
		gpio_pin_configure(btn->device, PIN_B, SW_FLAGS);
		
	}
}


void button_read(struct button *btn, u32_t *state){
	gpio_pin_read(btn->device, BUTTON, state);	
}

void button_read_pins(struct button *btn, u32_t *valA, u32_t *valB){
	gpio_pin_read(btn->device, PIN_A, valA);	
	gpio_pin_read(btn->device, PIN_B, valB);	
	
}

u32_t button_read_pinA(struct button *btn){
	u32_t val = 0U;
	gpio_pin_read(btn->device, PIN_A, &val);
	return val;
	
}
u32_t button_read_pinB(struct button *btn){
	u32_t val = 0U;
	gpio_pin_read(btn->device, PIN_B, &val);
	return val;
}
```

## src/ina.c
```c
#include "ina.h"

struct device *ina_dev;

u8_t data[2];
u32_t shunt_volt;
u32_t bus_volt;
u32_t current;
u32_t power;

int read_reg16(struct device *i2c_dev, u8_t reg_addr,
	       u8_t *data)
{
	u8_t wr_addr;
	struct i2c_msg msgs[2];

	/* Register address */
	wr_addr = reg_addr;

	/* Setup I2C messages */

	/* Send the address to read */
	msgs[0].buf = &wr_addr;
	msgs[0].len = 1U;
	msgs[0].flags = I2C_MSG_WRITE;

	/* Read from device. RESTART as neededm and STOP after this. */
	msgs[1].buf = data;
	msgs[1].len = 2U;
	msgs[1].flags = I2C_MSG_READ | I2C_MSG_RESTART | I2C_MSG_STOP;

	return i2c_transfer(i2c_dev, &msgs[0], 2, I2C_SLV_ADDR);
}

int write_reg16(struct device *i2c_dev, u8_t reg_addr,
		u8_t *data)
{
	u8_t wr_addr;
	struct i2c_msg msgs[2];

	/* Register address */
	wr_addr = reg_addr;

	/* Setup I2C messages */

	/* Send the address to read */
	msgs[0].buf = &wr_addr;
	msgs[0].len = 1U;
	msgs[0].flags = I2C_MSG_WRITE;

	/* Read from device. RESTART as neededm and STOP after this. */
	msgs[1].buf = data;
	msgs[1].len = 2U;
	msgs[1].flags = I2C_MSG_WRITE | I2C_MSG_STOP;

	return i2c_transfer(i2c_dev, &msgs[0], 2, I2C_SLV_ADDR);
}


void ina_calibration(void){
	ina_dev = device_get_binding("I2C_0");
	if (!ina_dev) {
		printk("I2C: Device not found.\n");
		return;
	}

	/* Configure the chip using default values */
	data[0] = 0x03;
	data[1] = 0x99;
	write_reg16(ina_dev, 0x00, data);

	/* Write the calibration value */
	data[0] = (CAL_VAL & 0xFF00) >> 8;
	data[1] = CAL_VAL & 0xFF;
	write_reg16(ina_dev, 0x05, data);
	
}


u32_t ina(u8_t st)
{
		
	if (!ina_dev) {
		printk("I2C: Device not found.\n");
		return;
	}
	
	u32_t aux;
	
		/* Read bus voltage */
	read_reg16(ina_dev, 0x02, data);
	bus_volt = (data[0] << 8) | data[1];
	bus_volt >>= 3; /* 3 LSBs are not data */
	bus_volt *= 4U; /* each LSB is 4 mV */
	//printk("Bus Voltage: %d mV\n", bus_volt);

	/* Read shunt voltage */
	read_reg16(ina_dev, 0x01, data);
	shunt_volt = (data[0] << 8) | data[1];
	shunt_volt *= 10U; /* to uV since each LSB is 0.01 mV */
	printk("\nVoltage: %d uV\n", shunt_volt);
	
	aux = shunt_volt - bus_volt/100;
	
	/* current by shunt */
	current = aux/100;
	printk("Current: %d mA\n", current);
	
	/* power */
	power = current * (aux/1000);
	printk("Power: %d uW\n", power);
	
	if(st == 0){
		return current;
	}
	else if(st == 1){
		return aux;
	}
	else return power;
	
}
```
